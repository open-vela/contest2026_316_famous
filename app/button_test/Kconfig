## app/button_test/Kconfig
```kconfig
# Button Test Demo Configuration
config APP_BUTTON_TEST
	bool "Button Test Demo"
	default y
	depends on INPUT_BUTTONS
	---help---
		Enable button test demo application for STM32F103ZET6.
		Tests USER button (PA0) with poll mechanism.
```

## app/led_blink/Kconfig
```kconfig
# LED Blink Demo Configuration
config APP_LEDBLINK
	bool "LED Blink Demo"
	default y
	depends on USERLED
	---help---
		Enable LED blink demo application for STM32F103ZET6.
		Blinks LED1 (PB0) at 500ms interval.
```

## board/contest_board/configs/nsh/defconfig
```kconfig
#
# NuttX defconfig for STM32F103ZET6 - Full Featured with Demos
# Contest 2026 team 316 - New Hardware Adaptation Track
#

# Architecture and Chip
CONFIG_ARCH="arm"
CONFIG_ARCH_ARM=y
CONFIG_ARCH_CHIP="stm32"
CONFIG_ARCH_CHIP_STM32=y
CONFIG_ARCH_CHIP_STM32F103ZE=y
CONFIG_STM32_STM32F10XX=y
CONFIG_ARCH_CORTEXM3=y
CONFIG_ARCH_NOFPU=y

# Board
CONFIG_ARCH_BOARD="contest2026_316_board"
CONFIG_ARCH_BOARD_CONTEST2026_316_BOARD=y

# Memory Layout (STM32F103ZET6: 64KB SRAM @ 0x20000000)
CONFIG_RAM_START=0x20000000
CONFIG_RAM_SIZE=65536
CONFIG_MM_REGIONS=1

# Clock Configuration (72MHz from HSE 8MHz + PLL)
CONFIG_BOARD_LOOPSPERMSEC=71

# Console USART (USART1: PA9=TX, PA10=RX)
CONFIG_STM32_USART1=y
CONFIG_USART1_SERIAL_CONSOLE=y
CONFIG_USART1_BAUD=115200
CONFIG_USART1_BITS=8
CONFIG_USART1_PARITY=0
CONFIG_USART1_2STOP=0

# Additional USART (USART2: PA2=TX, PA3=RX)
CONFIG_STM32_USART2=y

# JTAG/SWD Configuration
CONFIG_STM32_JTAG_SW_ENABLE=y

# System Settings
CONFIG_SYSTEM_NSH=y
CONFIG_INIT_ENTRYPOINT="nsh_main"

# Scheduler
CONFIG_RR_INTERVAL=200
CONFIG_SCHED_WAITPID=y
CONFIG_PREALLOC_TIMERS=4

# Stack Sizes
CONFIG_IDLETHREAD_STACKSIZE=2048
CONFIG_MAIN_STACKSIZE=4096
CONFIG_DEFAULT_TASK_STACKSIZE=4096

# Task Configuration
CONFIG_TASK_NAME_SIZE=16

# Debug Options
CONFIG_DEBUG_SYMBOLS=y
CONFIG_ARCH_STACKDUMP=y
CONFIG_INTELHEX_BINARY=y
CONFIG_RAW_BINARY=y

# Date/Time
CONFIG_START_DAY=4
CONFIG_START_MONTH=8
CONFIG_START_YEAR=2026

# NSH Configuration
CONFIG_NSH_READLINE=y
CONFIG_NSH_ARCHINIT=y
CONFIG_NSH_BUILTIN_APPS=y

# GPIO Support
CONFIG_ARCH_BUTTONS=y
CONFIG_ARCH_IRQBUTTONS=y
# CONFIG_ARCH_LEDS is not set
CONFIG_GPIO=y

# User LED driver (/dev/userleds)
CONFIG_USERLED=y
CONFIG_USERLED_LOWER=y

# Button input driver (/dev/buttons)
CONFIG_INPUT_BUTTONS=y
CONFIG_INPUT_BUTTONS_LOWER=y

# SPI Support
CONFIG_STM32_SPI1=y
CONFIG_SPI=y
CONFIG_SPI_EXCHANGE=y

# I2C Support
CONFIG_STM32_I2C1=y
CONFIG_I2C=y

# ADC Support
CONFIG_STM32_ADC1=y
CONFIG_ADC=y

# PWM Support
CONFIG_STM32_TIM1=y
CONFIG_STM32_TIM2=y
CONFIG_PWM=y

# Watchdog Timer
CONFIG_STM32_IWDG=y
CONFIG_WATCHDOG=y

# RTC (Real-Time Clock)
CONFIG_STM32_RTC=y
CONFIG_RTC=y

# DMA Support
CONFIG_STM32_DMA1=y

# File System Support
CONFIG_FS_FAT=y
CONFIG_FS_ROMFS=y
CONFIG_FS_PROCFS=y

# Application Demos
CONFIG_APP_LEDBLINK=y
CONFIG_APP_BUTTON_TEST=y
CONFIG_APP_SYSINFO=y

# Enable FPU (not available on Cortex-M3, keep disabled)
# CONFIG_ARCH_FPU is not set

# Disable unused features to save flash
# CONFIG_NET is not set
# CONFIG_AUDIO is not set
# CONFIG_VIDEO is not set
# CONFIG_GRAPHICS is not set
# CONFIG_WIRELESS is not set
# CONFIG_BLUETOOTH is not set
```
